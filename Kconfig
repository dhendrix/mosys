## Kconfig
```kconfig
mainmenu "mosys configuration"

# Internal stuff
config KERNELVERSION
	string
	option env="KERNELVERSION"

config UNITTEST
       bool
       option env="UNITTEST"

menu "General setup"
config ADVANCED_OPTIONS
	bool "Advanced configuration"
	default n
	help
	  This will enable advanced options to be selected and configured

config LOGLEVEL
	int "Log level threshold"
	range 0 8
	default 4
	help
	  Configure the verbosity of print statements in the code. Each 'v'
	  passed in using the command-line will increment the threshold by 1.
	  
	  Mnemonic     Value    Description
	  LOG_EMERG	0	system is unusable
	  LOG_ALERT	1	action must be taken immediately
	  LOG_CRIT	2	critical conditions
	  LOG_ERR	3	error conditions
	  LOG_WARNING	4	warning conditions
	  LOG_NOTICE	5	normal but significant condition
	  LOG_INFO	6	informational
	  LOG_DEBUG	7	debug-level messages	
	  LOG_SPEW	8	excessive debug messages

config USE_IPC_LOCK
	bool "Use IPC locking mechanism"
	default y
	help
	  The IPC locking mechanism ensures that mosys does not run at the
	  the same time as processes holding known IPC locks. For example,
	  this prevents multiple instances of mosys from running.

config DEBUG_INFO
	bool "Optimize mosys binary for debugging"
	default n
	help
	  This will add flags to the compiler to insert debugging info. Use
	  this to debug the actual binary, for example, if you are experiencing
	  instability (segfaults).

endmenu

source "intf/Kconfig"
source "platform/Kconfig"
source "drivers/Kconfig"
source "tools/Kconfig"
```

## drivers/Kconfig
```kconfig
# driver subdirectories will have Kconfig files to list symbols

menu "Device Drivers"

source "drivers/cypress/Kconfig"
source "drivers/google/Kconfig"
source "drivers/intel/Kconfig"
source "drivers/ite/Kconfig"
source "drivers/nuvoton/Kconfig"
source "drivers/nvidia/Kconfig"
source "drivers/samsung/Kconfig"
source "drivers/smsc/Kconfig"
source "drivers/ene/Kconfig"
source "drivers/sandisk/Kconfig"

endmenu
```

## drivers/cypress/Kconfig
```kconfig
# cypress config variables

config TRACKPAD_CYPRESS_APA
	bool "Cypress APA trackpad with I2C interface"
	default n
```

## drivers/google/Kconfig
```kconfig
# google config variables

config CROS_EC
	bool
	default n

config CROS_EC_I2C
        bool "I2C interface used in some Chromebook ECs"
	select CROS_EC
        default n

config CROS_EC_LPC
        bool "LPC interface used in some Chromebook ECs"
	select CROS_EC
        default n
```

## drivers/intel/Kconfig
```kconfig
# intel config variables

config CHIPSET_INTEL
	bool
	default n

config CHIPSET_INTEL_NM10
	bool "NM10"
	select CHIPSET_INTEL
	default n

config CHIPSET_INTEL_SERIES6
	bool "6-Series chipset"
	select CHIPSET_INTEL
	default n
	help
	  This currently includes the QM67, UM67, HM67, HM65, and QS67 SKUs

config CHIPSET_INTEL_LYNXPOINT_LP
	bool "Intel LynxPoint Low Power Chipset"
	select CHIPSET_INTEL
	default n

config SOC_INTEL_BAYTRAIL
	bool "Intel Baytrail SOC"
	default n

config SOC_INTEL_BRASWELL
	bool "Intel Braswell SOC"
	default n
```

## drivers/ite/Kconfig
```kconfig
# ite config variables

config EC_ITE_IT8500
	bool "IT8500"
	default n

config SUPERIO_ITE_IT8772
	bool "IT8772"
	default n
```

## drivers/nuvoton/Kconfig
```kconfig
# nuvoton config variables

config EC_NUVOTON_NPCE781
	bool "NPCE781"
	default n
```

## drivers/nvidia/Kconfig
```kconfig
# nvidia config variables

config SOC_NVIDIA
	bool
	default n

config SOC_NVIDIA_TEGRA124
	bool "Tegra 124"
	select SOC_NVIDIA
	default n
```

## drivers/samsung/Kconfig
```kconfig
# samsung config variables

config SOC_SAMSUNG
	bool
	default n

config SOC_SAMSUNG_EXYNOS5250
	bool "Exynos 5250"
	select SOC_SAMSUNG
	default n

config SOC_SAMSUNG_EXYNOS5420
	bool "Exynos 5420"
	select SOC_SAMSUNG
	default n
```

## platform/Kconfig
```kconfig
#
# Platform configuration
#

menu "Platforms"
config BIG_ENDIAN
	bool
	default n

config LITTLE_ENDIAN
	bool
	default n

choice PLATFORM_ARCH
	prompt "Platform Host Architecture"

config PLATFORM_ARCH_ARMEL
	bool "ARM endian-little platforms"
	select LITTLE_ENDIAN

config PLATFORM_ARCH_MIPSEL
	bool "MIPS endian-little platforms"
	select LITTLE_ENDIAN

config PLATFORM_ARCH_X86
	bool "x86 platforms"
	select LITTLE_ENDIAN

endchoice

config PLATFORM_EXPERIMENTAL
	bool "Experimental platform support"
	default n

config PLATFORM_AURON
	depends on PLATFORM_ARCH_X86
	select CHIPSET_INTEL_LYNXPOINT_LP
	select CROS_EC_LPC
	bool "Auron"
	default n

config PLATFORM_ALEX
	depends on PLATFORM_ARCH_X86
	select CHIPSET_INTEL_NM10
	select EC_SMSC_MEC1308
	bool "Samsung XE500 Chromebook"
	default n

config PLATFORM_BELTINO
	depends on PLATFORM_ARCH_X86
	select CHIPSET_INTEL_LYNXPOINT_LP
	bool "beltino"
	default n

config PLATFORM_BUTTERFLY
	depends on PLATFORM_ARCH_X86
	select CHIPSET_INTEL_SERIES6
	select EC_ENE_KB932
	select STORAGE_SANDISK_U100
	bool "HP Pavilion 14-c010us Chromebook"
	default n

config PLATFORM_CYAN
	depends on PLATFORM_ARCH_X86
	select CROS_EC_LPC
	select SOC_INTEL_BRASWELL
	bool "cyan"
	default n

config PLATFORM_CYCLONE
	depends on PLATFORM_ARCH_ARMEL
	bool "Cyclone"
	default n

config PLATFORM_DAISY
	depends on PLATFORM_ARCH_ARMEL
	select CROS_EC_I2C
	select SOC_SAMSUNG_EXYNOS5250
	bool "Samsung XE303 Chromebook"
	default n

config PLATFORM_FIZZ
	depends on PLATFORM_ARCH_X86
	select CROS_EC_LPC
	bool "fizz"
	default n

config PLATFORM_GLADOS
	depends on PLATFORM_ARCH_X86
	select CROS_EC_LPC
	#select CHIPSET_INTEL_LYNXPOINT_LP
	bool "glados"
	default n

config PLATFORM_GRU
	depends on PLATFORM_ARCH_ARMEL
	bool "Gru"
	default n

config PLATFORM_LINK
	depends on PLATFORM_ARCH_X86
	select CHIPSET_INTEL_SERIES6
	select CROS_EC_LPC
	bool "Google Pixel"
	default n

config PLATFORM_LUMPY
	depends on PLATFORM_ARCH_X86
	select CHIPSET_INTEL_SERIES6
	bool "Samsung XE550 Chromebook"
	default n

config PLATFORM_MARIO
	depends on PLATFORM_ARCH_X86
	select CHIPSET_INTEL_NM10
	select EC_ITE_IT8500
	bool "Google Cr-48 Chromebook"
	default n

config PLATFORM_NYAN
        depends on PLATFORM_ARCH_ARMEL
	select SOC_NVIDIA_TEGRA124
        select CROS_EC_SPI
        bool "nyan"
        default n

config PLATFORM_OAK
	depends on PLATFORM_ARCH_ARMEL
	bool "Oak"
	default n

config PLATFORM_PARROT
	depends on PLATFORM_ARCH_X86
	select CHIPSET_INTEL_SERIES6
	bool "Acer C7 Chromebook"
	default n

config PLATFORM_PEACH
	depends on PLATFORM_ARCH_ARMEL
	select CROS_EC_SPI
	select SOC_SAMSUNG_EXYNOS5420
	bool "Samsung Chromebook 2 (XE50312)"
	default n

config PLATFORM_PINKY
	depends on PLATFORM_ARCH_ARMEL
	bool "Pinky"
	default n

config PLATFORM_RAMBI
	depends on PLATFORM_ARCH_X86
	select CROS_EC_LPC
	select SOC_INTEL_BAYTRAIL
	bool "rambi"
	default n

config PLATFORM_REEF
	depends on PLATFORM_ARCH_X86
	select CROS_EC_LPC
	select SOC_INTEL_APOLLOLAKE
	bool "reef"
	default n

config PLATFORM_SAMUS
	depends on PLATFORM_ARCH_X86
	select CHIPSET_INTEL_LYNXPOINT_LP
	select CROS_EC_LPC
	bool "Samus"
	default n

config PLATFORM_SKATE
        depends on PLATFORM_ARCH_ARMEL
        select CROS_EC_I2C
        select SOC_SAMSUNG_EXYNOS5250
        bool "skate"
        default n

config PLATFORM_SLIPPY
	depends on PLATFORM_ARCH_X86
	select CHIPSET_INTEL_LYNXPOINT_LP
	select CROS_EC_LPC
	bool "slippy"
	default n

config PLATFORM_SMAUG
	depends on PLATFORM_ARCH_ARMEL
	select SOC_NVIDIA_TEGRA124
	select CROS_EC_I2C
	bool "smaug"
	default n

config PLATFORM_SPRING
	depends on PLATFORM_ARCH_ARMEL
	select CROS_EC_I2C
	select SOC_SAMSUNG_EXYNOS5250
	bool "HP Chromebook 11"
	default n

config PLATFORM_STORM
	depends on PLATFORM_ARCH_ARMEL
	bool "Storm"
	default n

config PLATFORM_STOUT
	depends on PLATFORM_ARCH_X86 && PLATFORM_EXPERIMENTAL
	select CHIPSET_INTEL_SERIES6
	select EC_ITE_IT8500
	select STORAGE_SANDISK_U100
	bool "Thinkpad X131e Chromebook"
	default n

config PLATFORM_STUMPY
	depends on PLATFORM_ARCH_X86
	select CHIPSET_INTEL_SERIES6
	select SUPERIO_ITE_IT8772
	bool "Samsung XE300 Chromebox"
	default n

config PLATFORM_STRAGO
	depends on PLATFORM_ARCH_X86
	select CROS_EC_LPC
	select SOC_INTEL_BRASWELL
	bool "strago"
	default n

config PLATFORM_ZGB
	depends on PLATFORM_ARCH_X86
	select CHIPSET_INTEL_NM10
	select EC_NUVOTON_NPCE781
	bool "Acer AC700 Chromebook"
	default n

config PLATFORM_Z600
	depends on PLATFORM_ARCH_X86
	bool "z600 workstation"
	default y

config EXPERIMENTAL_KIEV
	depends on PLATFORM_ARCH_X86 && PLATFORM_EXPERIMENTAL
	select CHIPSET_INTEL_SERIES6
	select SUPERIO_ITE_IT8772
	bool "kiev"
	default n

endmenu
```

## platform/acer/Kconfig
```kconfig
#
# Acer platform configuration
#

menu "Acer Platform Support"

config PLATFORM_PARROT
	depends on PLATFORM_ARCH_X86
	select CHIPSET_INTEL_SERIES6
	bool "Acer C7 Chromebook"
	default n

config PLATFORM_ZGB
	depends on PLATFORM_ARCH_X86
	select CHIPSET_INTEL_NM10
	select EC_NUVOTON_NPCE781
	bool "Acer AC700 Chromebook"
	default n

endmenu
```

## platform/asus/Kconfig
```kconfig
#
# Asus platform configuration
#

menu "Asus Platform Support"

config PLATFORM_PANTHER
	depends on PLATFORM_ARCH_X86
	select PLATFORM_BELTINO
	bool "Asus Chromebox"
	default n

endmenu
```

## platform/default/Kconfig
```kconfig
#
# Default platform configuration
#

menu "Default Platform Support"
config PLATFORM_DEFAULT
	bool "Default platform support"
	default n
	help
	  These are limited-functionality platform definitions that will allow
	  usage of a small, generic default subset of mosys functionality
	  for cases when the platform cannot be positively identified.
	  
	  The user must be careful not to allow multiple default platforms to
	  conflict when platform detection falls through to the default case.

config DEFAULT_X86
	depends on PLATFORM_ARCH_X86 && PLATFORM_DEFAULT
	bool "Default x86 functionality"
	default y
	help
	  This will provide minimal x86 support. Identification will be done
	  via SMBIOS table lookup.

endmenu
```

## platform/dell/Kconfig
```kconfig
#
# Dell platform configuration
#

menu "Dell Platform Support"

config PLATFORM_WOLF
	depends on PLATFORM_ARCH_X86
	bool "Dell Chromebook 11"
	select PLATFORM_SLIPPY
	default y

endmenu
```

## platform/experimental/Kconfig
```kconfig
#
# Experimental platform configuration
#

menu "Experimental Platform Support"

config PLATFORM_EXPERIMENTAL
	bool "Experimental platform support"
	default n

config EXPERIMENTAL_CYAN
	depends on PLATFORM_ARCH_X86 && PLATFORM_EXPERIMENTAL
	select CROS_EC_LPC
	select SOC_INTEL_BRASWELL
	bool "cyan"
	default n

config EXPERIMENTAL_GLADOS
	depends on PLATFORM_ARCH_X86 && PLATFORM_EXPERIMENTAL
	select CROS_EC_LPC
	#select CHIPSET_INTEL_LYNXPOINT_LP
	bool "glados"
	default n

config EXPERIMENTAL_KIEV
	depends on PLATFORM_ARCH_X86 && PLATFORM_EXPERIMENTAL
	select CHIPSET_INTEL_SERIES6
	select SUPERIO_ITE_IT8772
	bool "kiev"
	default n

config EXPERIMENTAL_STRAGO
	depends on PLATFORM_ARCH_X86 && PLATFORM_EXPERIMENTAL
	select CROS_EC_LPC
	select SOC_INTEL_BRASWELL
	bool "strago"
	default n

endmenu
```

## platform/google/Kconfig
```kconfig
#
# Google platform configuration
#

menu "Google Platform Support"

config PLATFORM_AURON
	depends on PLATFORM_ARCH_X86
	select CHIPSET_INTEL_LYNXPOINT_LP
	select CROS_EC_LPC
	bool "Auron"
	default n

config PLATFORM_BELTINO
	depends on PLATFORM_ARCH_X86
	select CHIPSET_INTEL_LYNXPOINT_LP
	bool "beltino"
	default n

config PLATFORM_CYAN
	depends on PLATFORM_ARCH_X86
	select CROS_EC_LPC
	select SOC_INTEL_BRASWELL
	bool "cyan"
	default n

config PLATFORM_CYCLONE
	depends on PLATFORM_ARCH_ARMEL
	bool "Cyclone"
	default n

config PLATFORM_GRU
	depends on PLATFORM_ARCH_ARMEL
	bool "Gru"
	default n

config PLATFORM_LINK
	depends on PLATFORM_ARCH_X86
	select CHIPSET_INTEL_SERIES6
	select CROS_EC_LPC
	bool "Google Pixel"
	default n

config PLATFORM_MARIO
	depends on PLATFORM_ARCH_X86
	select CHIPSET_INTEL_NM10
	select EC_ITE_IT8500
	bool "Google Cr-48 Chromebook"
	default n

config PLATFORM_NYAN
        depends on PLATFORM_ARCH_ARMEL
	select SOC_NVIDIA_TEGRA124
        select CROS_EC_SPI
        bool "nyan"
        default n

config PLATFORM_OAK
	depends on PLATFORM_ARCH_ARMEL
	bool "Oak"
	default n

config PLATFORM_PINKY
	depends on PLATFORM_ARCH_ARMEL
	bool "Pinky"
	default n

config PLATFORM_RAMBI
	depends on PLATFORM_ARCH_X86
	select CROS_EC_LPC
	select SOC_INTEL_BAYTRAIL
	bool "rambi"
	default n

config PLATFORM_REEF
	depends on PLATFORM_ARCH_X86
	select CROS_EC_LPC
	select SOC_INTEL_APOLLOLAKE
	bool "reef"
	default n

config PLATFORM_SMAUG
	depends on PLATFORM_ARCH_ARMEL
	select SOC_NVIDIA_TEGRA124
	select CROS_EC_I2C
	bool "smaug"
	default n

config PLATFORM_SAMUS
	depends on PLATFORM_ARCH_X86
	select CHIPSET_INTEL_LYNXPOINT_LP
	select CROS_EC_LPC
	bool "Samus"
	default n

config PLATFORM_SKATE
        depends on PLATFORM_ARCH_ARMEL
        select CROS_EC_I2C
        select SOC_SAMSUNG_EXYNOS5250
        bool "skate"
        default n

config PLATFORM_SLIPPY
	depends on PLATFORM_ARCH_X86
	select CHIPSET_INTEL_LYNXPOINT_LP
	select CROS_EC_LPC
	bool "slippy"
	default n

config PLATFORM_STORM
	depends on PLATFORM_ARCH_ARMEL
	bool "Storm"
	default n

endmenu
```

## platform/hp/Kconfig
```kconfig
#
# HP platform configuration
#

menu "HP Platform Support"

config PLATFORM_BUTTERFLY
	depends on PLATFORM_ARCH_X86
	select CHIPSET_INTEL_SERIES6
	select EC_ENE_KB932
	select STORAGE_SANDISK_U100
	bool "HP Pavilion 14-c010us Chromebook"
	default n

config PLATFORM_SPRING
        depends on PLATFORM_ARCH_ARMEL
        select CROS_EC_I2C
        select SOC_SAMSUNG_EXYNOS5250
        bool "HP Chromebook 11"
        default n

config PLATFORM_Z600
	depends on PLATFORM_ARCH_X86
	bool "z600 workstation"
	default y

endmenu
```

## platform/lenovo/Kconfig
```kconfig
#
# Lenovo platform configuration
#

menu "Lenovo Platform Support"

config PLATFORM_STOUT
	depends on PLATFORM_ARCH_X86 && PLATFORM_EXPERIMENTAL
	select CHIPSET_INTEL_SERIES6
	select EC_ITE_IT8500
	select STORAGE_SANDISK_U100
	bool "Thinkpad X131e Chromebook"
	default n

endmenu
```
