## platform/lg/Kconfig
```kconfig
#
# LG platform configuration
#

menu "LG Platform Support"

config PLATFORM_MONROE
	depends on PLATFORM_ARCH_X86
	select PLATFORM_BELTINO
	bool "LG ChromeBase 22VC241-W"
	default n

endmenu
```

## platform/samsung/Kconfig
```kconfig
#
# Samsung platform configuration
#

menu "Samsung Platform Support"

config PLATFORM_ALEX
	depends on PLATFORM_ARCH_X86
	select CHIPSET_INTEL_NM10
	select EC_SMSC_MEC1308
	bool "Samsung XE500 Chromebook"
	default n

config PLATFORM_DAISY
	depends on PLATFORM_ARCH_ARMEL
	select CROS_EC_I2C
	select SOC_SAMSUNG_EXYNOS5250
	bool "Samsung XE303 Chromebook"
	default n

config PLATFORM_LUMPY
	depends on PLATFORM_ARCH_X86
	select CHIPSET_INTEL_SERIES6
	bool "Samsung XE550 Chromebook"
	default n

config PLATFORM_STUMPY
	depends on PLATFORM_ARCH_X86
	select CHIPSET_INTEL_SERIES6
	select SUPERIO_ITE_IT8772
	bool "Samsung XE300 Chromebox"
	default n

endmenu
```

## platform/toshiba/Kconfig
```kconfig
#
# Toshiba platform configuration
#

menu "Toshiba Platform Support"

config PLATFORM_LEON
	depends on PLATFORM_ARCH_X86
	bool "Toshiba Chromebook"
	select PLATFORM_SLIPPY
	default y

endmenu
```

## tools/Kconfig
```kconfig
#
# Tools configuration
#

menu "Tools"

# hack to ensure libraries are linked in (e.g. -luuid)
config ADD_TOOL_LIBRARIES
	bool
	default n

config BUILD_VPD
        bool "Vital Product Data (VPD) encoder"
	select ADD_TOOL_LIBRARIES
	default n
	help
	  This option will cause VPD to be built using the specified
	  configuration options.

source "tools/vpd_encode/Kconfig"

endmenu
```

## tools/vpd_encode/Kconfig
```kconfig
#
# Vital Product Data (VPD) Configuration
#

menu "Vital Product Data (VPD) Configuration"
	depends on BUILD_VPD

config VPD_ADVANCED_OPTIONS
	bool "Configure optional fields and advanced options"
	default n

#config INFILE
#	string "VPD input file (if any)"
#	help
#	  Input filename (if any)

config VPD_OUTFILE
	string "VPD output file"
	default "vpd.bin"
	help
	  File to write VPD to.

source "tools/vpd_encode/Kconfig.entry"

config BUILD_VPD_TYPE0_STRUCTURE
	bool "Type 0 (firmware information) structure"
	default y
source "tools/vpd_encode/Kconfig.type0"

config BUILD_VPD_TYPE1_STRUCTURE
	bool "Type 1 (system information) structure"
	default y
source "tools/vpd_encode/Kconfig.type1"

source "tools/vpd_encode/Kconfig.type241"
source "tools/vpd_encode/Kconfig.blobs"

endmenu
```

## tools/vpd_encode/Kconfig.agz_blob
```kconfig
#
# AGZ Blob Configuration (version 3)
#

menu "AGZ Blob Configuration (version 3)"
	depends on BUILD_AGZ_VENDOR_VPD_BLOB

config AGZ_BLOB_FILENAME
	string "Output filename"
	default "agz_blob.bin"
	help
	  Output filename for AGZ blob

config AGZ_BLOB_PRODUCT_NAME
	string "Product Name"
	default "To be filled in"
	help
	  16 character freeform string
	  Unused nibbles or bytes will be zero-filled (0h or 00h).

config AGZ_BLOB_PRODUCT_MFG
	string "Product Manufacturer"
	default "To be filled in"
	help
	  16 character freeform string
	  Unused nibbles or bytes will be zero-filled (0h or 00h).

config AGZ_BLOB_UUID
	string "UUID"
	default "00000000-0000-0000-0000-000000000000"
        help
          128-bit UUID, obeying RFC4122 format.
          Example: 0bf40e9f-e9e9-4c42-a39b-ee1c54a4359a

config AGZ_BLOB_MB_SERIAL_NUMBER
	string "Motherboard Serial Number"
	default "00112233445566778899aabbccddeeff"
	help
	  32 character string of hexadecimal digits (16 bytes).
	  Unused nibbles or bytes will be zero-filled (0h or 00h).

config AGZ_BLOB_3G_ESN
	string "3G ESN"
	default "22-666666-666666-1"
	help
	  10-byte ESN
	  Format for IMEI: AA-BBBBBB-CCCCCC-D

config AGZ_BLOB_LOCAL_COUNTRY_CODE
	string "Local Country Code"
	default "TBD"
	help
	  6 character freeform string
	  Unused nibbles or bytes will be zero-filled (0h or 00h).

config AGZ_BLOB_WLAN_MAC_ADDRESS
	string "WLAN MAC Address"
	default "00:00:00:00:00:00"
	help
	  Format for IEEE802.x MAC Address: 01:23:45:67:89:ab

config AGZ_BLOB_PRODUCT_SERIAL_NUMBER
	string "Product Serial Number"
	default "To be filled in"
	help
	  22 character string
	  Unused nibbles or bytes will be zero-filled (0h or 00h).

endmenu # AGZ Blob Configuration
```

## tools/vpd_encode/Kconfig.agz_blob_v5
```kconfig
#
# AGZ Blob Configuration (version 5)
#

menu "AGZ Blob Configuration (version 5)"
	depends on BUILD_AGZ_VENDOR_VPD_BLOB_V5

config AGZ_BLOB_V5_FILENAME
	string "Output filename"
	default "agz_blob_v5.bin"
	help
	  Output filename for AGZ blob

config AGZ_BLOB_V5_PRODUCT_NAME
	string "Product Name"
	default "To be filled in"
	help
	  16 character freeform ASCII string
	  Unused nibbles or bytes will be zero-filled (0h or 00h).

config AGZ_BLOB_V5_PRODUCT_MFG
	string "Product Manufacturer"
	default "To be filled in"
	help
	  16 character freeform ASCII string
	  Unused nibbles or bytes will be zero-filled (0h or 00h).

config AGZ_BLOB_V5_UUID
	string "UUID"
	default "00000000-0000-0000-0000-000000000000"
        help
          128-bit UUID, obeying RFC4122 format.
          Example: 0bf40e9f-e9e9-4c42-a39b-ee1c54a4359a

config AGZ_BLOB_V5_MB_SERIAL_NUMBER
	string "Motherboard Serial Number"
	default "00112233445566778899aabbccddeeff"
	help
	  32 character freeform ASCII string.
	  Unused nibbles or bytes will be zero-filled (0h or 00h).

config AGZ_BLOB_V5_3G_ESN
	string "3G ESN"
	default "01234abcde"
	help
	  10-byte ESN (hex digits)
	  Unused nibbles or bytes will be zero-filled (0h or 00h).

config AGZ_BLOB_V5_LOCAL_COUNTRY_CODE
	string "Local Country Code"
	default "TBD"
	help
	  6 character freeform ASCII string
	  Unused nibbles or bytes will be zero-filled (0h or 00h).

config AGZ_BLOB_V5_WLAN_MAC_ADDRESS
	string "WLAN MAC Address"
	default "00:00:00:00:00:00"
	help
	  Format for IEEE802.x MAC Address: 01:23:45:67:89:ab

config AGZ_BLOB_V5_PRODUCT_SERIAL_NUMBER
	string "Product Serial Number"
	default "To be filled in"
	help
	  22 character freeform ASCII string
	  Unused nibbles or bytes will be zero-filled (0h or 00h).

endmenu # AGZ Blob Configuration
```

## tools/vpd_encode/Kconfig.blobs
```kconfig
#
# Binary Blob Configuration
#

menu "Binary Blob Configuration"
	depends on BUILD_VPD

# Binary blob targets
config BUILD_AGZ_VENDOR_VPD_BLOB_V3
	bool "Build AGZ blob v3"
	default n
source "tools/vpd_encode/Kconfig.agz_blob_v3"

config BUILD_AGZ_VENDOR_VPD_BLOB_V5
	bool "Build AGZ blob v5"
	default n
source "tools/vpd_encode/Kconfig.agz_blob_v5"

config BUILD_GOOGLE_VPD_BLOB_V1_1
	bool "Build Google blob v1.1"
	default n
source "tools/vpd_encode/Kconfig.google_blob_v1.1"

endmenu # Binary Blob Configuration
```

## tools/vpd_encode/Kconfig.entry
```kconfig
#
# Entry point configuration
#

menu "Entry Point Structure"
	depends on BUILD_VPD

config EPS_VPD_MAJOR_VERSION
	int "VPD major version"
	range 0 255
	default 2
	help
	  VPD major version (0-255)

config EPS_VPD_MINOR_VERSION
	int "VPD minor version"
	range 0 255
	default 6
	help
	  VPD minor version (0-255)

config EPS_STRUCTURE_TABLE_ADDRESS
	hex "Structure table address"
	default 0x1f
#FIXME: this really should have a range...
#	range 0 0xffffffff
	help
	  32-bit address offset of structure table.

	  If you wish to relocate the structure table, then set this value
	  to point at the new location. By default, the structure table will
	  immediately follow the entry point structure, relative to offset zero.

config EPS_NUM_STRUCTURES
	depends on VPD_ADVANCED_OPTIONS
	int "Number of structures (not counting entry point)"
	range 0 65536
	help
	  Number of structures in the table structure. Do not include the
	  entry point structure in this value.

endmenu # VPD Entry Point
```

## tools/vpd_encode/Kconfig.google_blob_v1.1
```kconfig
#
# Google Blob v1.1 Configuration
#

menu "Google Blob v1.1 Configuration"
	depends on BUILD_GOOGLE_VPD_BLOB_V1_1

config GOOGLE_BLOB_V1_1_FILENAME
	string "Output filename"
	default "google_blob_v1.1.bin"
	help
	  Output filename for Google VPD blob

config GOOGLE_BLOB_V1_1_PRODUCT_SERIAL_NUMBER
	string "Product Serial Number"
	default "To be filled in"
	help
	  32 character freeform ASCII string
	  Unused nibbles or bytes will be zero-filled (0h or 00h).

config GOOGLE_BLOB_V1_1_PRODUCT_SKU
	string "Product SKU"
	default "To be filled in"
	help
	  16 character freeform ASCII string
	  Unused nibbles or bytes will be zero-filled (0h or 00h).

config GOOGLE_BLOB_V1_1_UUID
	string "UUID"
	default "88888888-4444-4444-4444-121212121212"
        help
          128-bit UUID, obeying RFC4122 format.
          Example: 0bf40e9f-e9e9-4c42-a39b-ee1c54a4359a

config GOOGLE_BLOB_V1_1_MB_SERIAL_NUMBER
	string "Motherboard Serial Number"
	default "To be filled in"
	help
	  16 character freeform ASCII string.
	  Unused nibbles or bytes will be zero-filled (0h or 00h).

config GOOGLE_BLOB_V1_1_3G_IMEI
	string "3G IMEI"
	default "01234abcde"
	help
	  16-byte 3G IMEI (ASCII)
	  Unused nibbles or bytes will be zero-filled (0h or 00h).

config GOOGLE_BLOB_V1_1_SSD_SERIAL_NUMBER
	string "SSD Serial Number"
	default "To be filled in"
	help
	  16 character freeform ASCII string
	  Unused nibbles or bytes will be zero-filled (0h or 00h).

config GOOGLE_BLOB_V1_1_MEMORY_SERIAL_NUMBER
	string "Memory Serial Number"
	default "To be filled in"
	help
	  16 character freeform ASCII string
	  Unused nibbles or bytes will be zero-filled (0h or 00h).

config GOOGLE_BLOB_V1_1_WLAN_MAC_ADDRESS
	string "WLAN MAC Address"
	default "01:23:45:67:89:ab"
	help
	  Format for IEEE802.x MAC Address: 01:23:45:67:89:ab

endmenu # Google Blob Configuration
```

## tools/vpd_encode/Kconfig.type0
```kconfig
#
# Firmware information configuration
#

menu "Firmware Information (Type 0)"
	depends on BUILD_VPD_TYPE0_STRUCTURE

config FIRMWARE_VENDOR
	string "Firmware vendor"
	default "To be filled in"

config FIRMWARE_VERSION
	string "Firmware version string"
	default "To be filled in"
	help
	  This is a freeform string that may contain core and OEM version
	  information.

config FIRMWARE_RELEASE_DATE
	string "Firmware release date (mm/dd/yyyy)"
	default "01/01/1970"
	help
	  String number fo the firmware release date. The date string, if
	  supplied, is mm/dd/yyyy format.

config FIRMWARE_START
	depends on VPD_ADVANCED_OPTIONS
	string "Firmware start location"
	default 0
	help
	  Native address offset of firmware runtime image, relative
	  to beginning of ROM. This should be presented as the CPU-native
	  addressing format when the CPU is first powered on (byte offset
	  or segment descriptor).

config FIRMWARE_ROM_SIZE
	int "Size of system firmware ROM (in 64KB blocks)"
	default 64
#FIXME: this may need disambiguation; see SMBIOS spec
	help
	  Integer size of the physical memory on which the system firmware is
	  stored, in bytes, divided by 64KB (2^16).

# FIXME: We don't intend on using these, but it might be nice to make them
# configurable anyway.
#config FIRMWARE_CHARACTERISTICS
#config FIRMWARE_CHARACTERISTICS_EXTENSION

config SYSTEM_FIRMWARE_MAJOR_RELEASE
	int "System firmware major release number"
	default 0

config SYSTEM_FIRMWARE_MINOR_RELEASE
	int "System firmware minor release number"
	default 0

config EC_FIRMWARE_MAJOR_RELEASE
	int "Embedded controller firmware major release number"
	default 0

config EC_FIRMWARE_MINOR_RELEASE
	int "Embedded controller firmware minor release number"
	default 0

endmenu # Firmware Information (Type 0)
```

## tools/vpd_encode/Kconfig.type1
```kconfig
#
# System information configuration
#

menu "System Information (Type 1)"
	depends on BUILD_VPD

config SYSTEM_MANUFACTURER
	string "System manufacturer"
	default "To be filled in"

config SYSTEM_PRODUCT_NAME
	string "System product name"
	default "To be filled in"

config SYSTEM_VERSION
	string "System version"
	default "To be filled in"

config SYSTEM_SERIAL_NUMBER
	string "System serial number"
	default "To be filled in"

config SYSTEM_UUID
	string "System UUID"
	default "00000000-0000-0000-0000-000000000000"
	help
	  128-bit UUID, obeying RFC4122 format.
	  Example: 0bf40e9f-e9e9-4c42-a39b-ee1c54a4359a

#config SYSTEM_WAKEUP_TYPE

config SYSTEM_SKU
	string "System SKU"
	default "To be filled in"

config SYSTEM_FAMILY
	string "System family"
	default "To be filled in"

endmenu	# System Information (Type 1)
```

## tools/vpd_encode/Kconfig.type240
```kconfig
#
# Google Chrome OS OEM custom information configuration
#

menu "Google Chrome OS OEM Custom Information (Type 240)"
config GOOGLE_CUSTOM_STRUCT_MAJOR_VERSION
	int "Major version"
	range 0 255
	default 1

config GOOGLE_CUSTOM_STRUCT_MINOR_VERSION
	int "Minor version"
	range 0 255
	default 0

config GOOGLE_CUSTOM_STRUCT_EXTRA_VERSION
	string "Extra version"

config GOOGLE_CUSTOM_NUM_NICS
	int "Number of network interface devices present"
#FIXME: This imposes a limit of 8.
	range 0 8
	help
	  This indicates the number of networking interface devices
	  (each with a unique ID) in the system.

# FIXME: Maybe this can be done a better way?
menuconfig NIC0_PRESENT
	bool "NIC0 Config"
choice
	prompt "NIC0 type"
	depends on NIC0_PRESENT
config NIC0_TYPE_UNSPECIFIED
	bool "Unspecified"

config NIC0_TYPE_IEEE802
	bool "IEEE 802 MAC-48"

config NIC0_TYPE_IMEI
	bool "IMEI (14 digits plus check digit)"

config NIC0_TYPE_IMEISV
	bool "IMEI/SV (16 digits)"

config NIC0_TYPE_MEID
	bool "MEID (56-bits / 14 hex digits)"
endchoice
config NIC0_ID
	depends on NIC0_PRESENT
	string "NIC0 network device ID"
	help
	  Format for IEEE 802: 01:23:45:67:89:ab
	  Format for IMEI: AA-BBBBBB-CCCCCC-D
	  FOrmat for IMEI/SV: AA-BBBBBB-CCCCCC-EE
	  Format for MEID: RRXXXXXXZZZZZZ

menuconfig NIC1_PRESENT
	bool "NIC1 Config"
choice
	prompt "NIC1 type"
	depends on NIC1_PRESENT
config NIC1_TYPE_UNSPECIFIED
	bool "Unspecified"
config NIC1_TYPE_IEEE802
	bool "IEEE 802 MAC-48"
config NIC1_TYPE_IMEI
	bool "IMEI (14 digits plus check digit)"
config NIC1_TYPE_IMEISV
	bool "IMEI/SV (16 digits)"
config NIC1_TYPE_MEID
	bool "MEID (56-bits / 14 hex digits)"
endchoice

config NIC1_ID
	depends on NIC1_PRESENT
	string "NIC1 network device ID"
	help
	  Format for IEEE 802: 01:23:45:67:89:ab
	  Format for IMEI: AA-BBBBBB-CCCCCC-D
	  FOrmat for IMEI/SV: AA-BBBBBB-CCCCCC-EE
	  Format for MEID: RRXXXXXXZZZZZZ

menuconfig NIC2_PRESENT
	bool "NIC2 Config"
choice
	prompt "NIC2 type"
	depends on NIC2_PRESENT
config NIC2_TYPE_UNSPECIFIED
	bool "Unspecified"
config NIC2_TYPE_IEEE802
	bool "IEEE 802 MAC-48"
config NIC2_TYPE_IMEI
	bool "IMEI (14 digits plus check digit)"
config NIC2_TYPE_IMEISV
	bool "IMEI/SV (16 digits)"
config NIC2_TYPE_MEID
	bool "MEID (56-bits / 14 hex digits)"
endchoice
config NIC2_ID
	depends on NIC2_PRESENT
	string "NIC2 network device ID"
	help
	  Format for IEEE 802: 01:23:45:67:89:ab
	  Format for IMEI: AA-BBBBBB-CCCCCC-D
	  FOrmat for IMEI/SV: AA-BBBBBB-CCCCCC-EE
	  Format for MEID: RRXXXXXXZZZZZZ

menuconfig NIC3_PRESENT
	bool "NIC3 Config"
choice
	prompt "NIC3 type"
	depends on NIC3_PRESENT
config NIC3_TYPE_UNSPECIFIED
	bool "Unspecified"
config NIC3_TYPE_IEEE802
	bool "IEEE 802 MAC-48"
config NIC3_TYPE_IMEI
	bool "IMEI (14 digits plus check digit)"
config NIC3_TYPE_IMEISV
	bool "IMEI/SV (16 digits)"
config NIC3_TYPE_MEID
	bool "MEID (56-bits / 14 hex digits)"
endchoice
config NIC3_ID
	depends on NIC3_PRESENT
	string "NIC3 network device ID"
	help
	  Format for IEEE 802: 01:23:45:67:89:ab
	  Format for IMEI: AA-BBBBBB-CCCCCC-D
	  FOrmat for IMEI/SV: AA-BBBBBB-CCCCCC-EE
	  Format for MEID: RRXXXXXXZZZZZZ

# Experimental stuff...
#if GOOGLE_CUSTOM_NUM_NICS=4
#config FOOBAR
#	select NIC4_PRESENT
#endif
#config GOOGLE_CUSTOM_NIC4_TYPE
#	depends on NIC4_PRESENT
#	int "NIC4 type"
#	range 0 255
#config GOOGLE_CUSTOM_NIC4_ID
#	depends on NIC4_PRESENT
#	string "NIC4 network device ID"

#config FOO
#	depends on GOOGLE_CUSTOM_NUM_NICS >= 4
#	int "foo"

# FIXME: Add in more NICs

endmenu	# end Google Chrome OS OEM Custom Information (Type 240)
```
