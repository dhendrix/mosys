## tools/vpd_encode/Kconfig.type241
```kconfig
#
# Binary blob pointer
#

# FIXME: This is extremely hacky. We should modify Kconfig to do arithmetic
# comparisons (==, >=, etc).

config BINARY_BLOB_POINTERS
	bool "Configure binary blob pointers"
	default n
	help
	  Select this if binary blobs are present.

config NUM_BINARY_BLOB_POINTERS
	int "Number of binary blobs present"
	depends on BINARY_BLOB_POINTERS
	default 0
	range 0 4
	help
	  Total number of binary blobs present in the EEPROM

# The BUILD_BBP* variables are a hacky way of making configuration for each
# binary point blob visible in Kconfig on an as-needed basis. We can move the
# dependencies to individual Kconfig files, but that merely scatters the gross
# hack across several files...

config BUILD_BBP0
	bool
	depends on NUM_BINARY_BLOB_POINTERS="1" || \
	           NUM_BINARY_BLOB_POINTERS="2"
	default y

config BUILD_BBP1
	bool
	depends on NUM_BINARY_BLOB_POINTERS="2"
	default y

source "tools/vpd_encode/Kconfig.type241_handle0"
source "tools/vpd_encode/Kconfig.type241_handle1"
```

## tools/vpd_encode/Kconfig.type241_handle0
```kconfig
#
# Binary blob pointer #0 configuration
#

menu "Binary Blob Pointer (Handle == 0)"
	depends on BUILD_BBP0

config BBP0_STRUCTURE_MAJOR_VERSION
	int "Structure major version"
	range 0 255
	default 0

config BBP0_STRUCTURE_MINOR_VERSION
	int "Structure minor version"
	range 0 255
	default 0

config BBP0_VENDOR
	string "Blob vendor"
	default "To be filled in"

config BBP0_DESCRIPTION
	string "Blob description"
	default "To be filled in"
	help
	  Freeform description of blob.

config BBP0_BLOB_MAJOR_VERSION
	int "Blob major version"
	range 0 255
	default 0

config BBP0_BLOB_MINOR_VERSION
	int "Blob minor version"
	range 0 255
	default 0

config BBP0_BLOB_VARIANT
	string "Blob variant"
	default "To be filled in"

config BBP0_UUID
	string "Blob UUID"
	default "00000000-0000-0000-0000-000000000000"
	help
	  128-bit UUID, obeying RFC4122 format.
	  Example: 0bf40e9f-e9e9-4c42-a39b-ee1c54a4359a

config BBP0_OFFSET
	hex "Blob offset"
	default 0
	help
	  Blob offset, relative to address 0 of the EEPROM

config BBP0_SIZE
	int "Blob size (in bytes)"
	default 0

endmenu # Binary Blob Pointer (Handle == 0)
```

## tools/vpd_encode/Kconfig.type241_handle1
```kconfig
#
# Binary blob pointer #1 configuration
#

menu "Binary Blob Pointer (Handle == 1)"
	depends on BUILD_BBP1

config BBP1_STRUCTURE_MAJOR_VERSION
	int "Structure major version"
	range 0 255
	default 1

config BBP1_STRUCTURE_MINOR_VERSION
	int "Structure minor version"
	range 0 255
	default 0

config BBP1_VENDOR
	string "Blob vendor"
	default "To be filled in"

config BBP1_DESCRIPTION
	string "Blob description"
	default "To be filled in"
	help
	  Freeform description of blob.

config BBP1_BLOB_MAJOR_VERSION
	int "Blob major version"
	range 0 255
	default 0

config BBP1_BLOB_MINOR_VERSION
	int "Blob minor version"
	range 0 255
	default 0

config BBP1_BLOB_VARIANT
	string "Blob variant"
	default "To be filled in"

config BBP1_UUID
	string "Blob UUID"
	default "00000000-0000-0000-0000-000000000000"
	help
	  128-bit UUID, obeying RFC4122 format.
	  Example: 0bf40e9f-e9e9-4c42-a39b-ee1c54a4359a

config BBP1_OFFSET
	hex "Blob offset"
	default 0
	help
	  Blob offset, relative to address 0 of the EEPROM

config BBP1_SIZE
	int "Blob size (in bytes)"
	default 0

endmenu # Binary Blob Pointer (Handle == 1)
```
